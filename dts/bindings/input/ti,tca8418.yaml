## dts/bindings/input/ti,tca8418.yaml
```yaml
# SPDX-FileCopyrightText: Copyright The Zephyr Project Contributors
# SPDX-License-Identifier: Apache-2.0

title: TI TCA8418 I2C keypad scan controller

description: |
  The TCA8418 scans a matrix of up to 8 rows and 10 columns by itself and
  queues key presses and releases in a FIFO. Each event is reported as
  INPUT_ABS_X (column), INPUT_ABS_Y (row) and INPUT_BTN_TOUCH (pressed),
  the convention of the keyboard matrix drivers, so an input-keymap child
  node can translate them into key codes.

  Rows 0 to row-size - 1 and columns 0 to col-size - 1 are used for the
  matrix; the other pins stay GPIOs.

compatible: "ti,tca8418"

include: i2c-device.yaml

properties:
  int-gpios:
    type: phandle-array
    description: |
      Interrupt line (open drain, active low), asserted while key events are
      queued. The controller is polled every poll-period-ms when this
      property is absent.

  reset-gpios:
    type: phandle-array
    description: |
      Reset line (active low). The driver pulses it at initialization when
      present.

  row-size:
    type: int
    required: true
    description: Number of matrix rows, starting from ROW0 (1 to 8).

  col-size:
    type: int
    required: true
    description: Number of matrix columns, starting from COL0 (1 to 10).

  poll-period-ms:
    type: int
    default: 20
    description: Polling period in milliseconds when int-gpios is absent.

examples:
  - |
    #include <zephyr/dt-bindings/gpio/gpio.h>
    #include <zephyr/dt-bindings/input/input-event-codes.h>
    #include <zephyr/dt-bindings/input/keymap.h>

    &i2c1 {
      keypad@34 {
        compatible = "ti,tca8418";
        reg = <0x34>;
        int-gpios = <&gpio0 13 (GPIO_ACTIVE_LOW | GPIO_PULL_UP)>;
        reset-gpios = <&gpio1 16 GPIO_ACTIVE_LOW>;
        row-size = <2>;
        col-size = <2>;

        keymap {
          compatible = "input-keymap";
          keymap = <MATRIX_KEY(0, 0, INPUT_KEY_UP)
                    MATRIX_KEY(0, 1, INPUT_KEY_DOWN)
                    MATRIX_KEY(1, 0, INPUT_KEY_ENTER)
                    MATRIX_KEY(1, 1, INPUT_KEY_ESC)>;
          row-size = <2>;
          col-size = <2>;
        };
      };
    };
```

## dts/bindings/led/badgeteam,mch2022-rp2040-backlight.yaml
```yaml
# SPDX-FileCopyrightText: Copyright The Zephyr Project Contributors
# SPDX-License-Identifier: Apache-2.0

description: |
  MCH2022 badge LCD backlight, dimmed by the RP2040 coprocessor

  Must be a child of a badgeteam,mch2022-rp2040 node. The backlight is LED 0;
  the coprocessor turns it fully on when it starts.

compatible: "badgeteam,mch2022-rp2040-backlight"
```

## dts/bindings/mfd/badgeteam,mch2022-rp2040.yaml
```yaml
# SPDX-FileCopyrightText: Copyright The Zephyr Project Contributors
# SPDX-License-Identifier: Apache-2.0

description: |
  MCH2022 badge RP2040 coprocessor

  The badge's RP2040 bridges USB to the ESP32 and reads the buttons, the
  battery and USB voltages and the FPGA's CDONE line. It answers on I2C at
  address 0x17 and drives an active-low interrupt line on button changes.

  Example:

    rp2040: coprocessor@17 {
            compatible = "badgeteam,mch2022-rp2040";
            reg = <0x17>;

            buttons {
                    compatible = "badgeteam,mch2022-rp2040-input";
                    int-gpios = <&gpio1 2 GPIO_ACTIVE_LOW>;
            };

            backlight: backlight {
                    compatible = "badgeteam,mch2022-rp2040-backlight";
            };
    };

compatible: "badgeteam,mch2022-rp2040"

include: i2c-device.yaml
```

## soc/espressif/esp32s3/Kconfig.defconfig
```kconfig
# Copyright (c) 2023 Espressif Systems (Shanghai) Co., Ltd.
# SPDX-License-Identifier: Apache-2.0

if SOC_SERIES_ESP32S3

configdefault CACHE_MANAGEMENT
	default y

choice CACHE_TYPE
	default EXTERNAL_CACHE if CACHE_MANAGEMENT
endchoice

config BOOTLOADER_MCUBOOT
	default y if SOC_ESP32S3_APPCPU

config MAIN_STACK_SIZE
	default 4096

if SMP

config MP_MAX_NUM_CPUS
	default 2

config SCHED_CPU_MASK
	default y

config ESP32_TIMER_IN_IRAM
	default y

endif # SMP

if PM && TICKLESS_KERNEL

choice XTENSA_TIMER_LPM_TIMER
	default XTENSA_TIMER_LPM_TIMER_HOOK
endchoice

endif # PM && TICKLESS_KERNEL

# External RAM through the data cache: S32C1I is not atomic there, as
# esp_cpu_compare_and_set() in the HAL knows.
config XTENSA_ATOMIC_EMULATED_START
	default 0x3c000000

config XTENSA_ATOMIC_EMULATED_END
	default 0x3e000000

endif # SOC_SERIES_ESP32S3
```

## subsys/usb/device_next/class/Kconfig.cdc_ncm
```kconfig
# Copyright (c) 2024 Nordic Semiconductor ASA
#
# SPDX-License-Identifier: Apache-2.0

config USBD_CDC_NCM_CLASS
	bool "USB CDC NCM implementation"
	default y
	depends on NET_L2_ETHERNET
	depends on DT_HAS_ZEPHYR_CDC_NCM_ETHERNET_ENABLED
	help
	  USB CDC Network Control Model (NCM) implementation

if USBD_CDC_NCM_CLASS

config USBD_CDC_NCM_MAX_DGRAM_PER_NTB
	int "Max number of received datagrams per NTB"
	range 0 $(UINT16_MAX)
	default 2
	help
	  How many datagrams we are able to receive per NTB.

config USBD_CDC_NCM_RECV_NTB_MAX_SIZE
	int "Max size of a received NTB"
	range 2048 65535
	default 2048
	help
	  Largest OUT NTB (dwNtbOutMaxSize) the host may send, in bytes. Room
	  for several datagrams lets the host aggregate them into one
	  transfer, together with USBD_CDC_NCM_MAX_DGRAM_PER_NTB.

config USBD_CDC_NCM_SEND_NTB_MAX_SIZE
	int "Max size of a sent NTB"
	range 2048 65535
	default 2048
	help
	  Largest IN NTB (dwNtbInMaxSize) the device sends, in bytes.

config USBD_CDC_NCM_SEND_MAX_DGRAM_PER_NTB
	int "Max number of sent datagrams per NTB"
	range 1 $(UINT16_MAX)
	default 1
	help
	  More than one makes sending asynchronous: datagrams queued while an
	  IN transfer is in flight are collected into a second NTB, sent as
	  soon as the first completes. This takes a second IN buffer and
	  USBD_CDC_NCM_SEND_NTB_MAX_SIZE must leave room for the datagrams.

config USBD_CDC_NCM_SUPPORT_NTB32
	bool "Support NTB32 format"
	help
	  Enable support for NTB32 format which allows larger
	  packet sizes.

module = USBD_CDC_NCM
module-str = usbd cdc_ncm
source "subsys/logging/Kconfig.template.log_config"

endif
```
