## boards/badgeteam/mch2022/Kconfig
```kconfig
# SPDX-FileCopyrightText: Copyright The Zephyr Project Contributors
# SPDX-License-Identifier: Apache-2.0

config HEAP_MEM_POOL_ADD_SIZE_BOARD
	int
	default 4096 if BOARD_MCH2022_ESP32_PROCPU
	default 256 if BOARD_MCH2022_ESP32_APPCPU
```

## boards/badgeteam/mch2022/Kconfig.mch2022
```kconfig
# SPDX-FileCopyrightText: Copyright The Zephyr Project Contributors
# SPDX-License-Identifier: Apache-2.0

config BOARD_MCH2022
	select SOC_ESP32
	select SOC_ESP32_PROCPU if BOARD_MCH2022_ESP32_PROCPU
	select SOC_ESP32_APPCPU if BOARD_MCH2022_ESP32_APPCPU
```

## boards/badgeteam/mch2022/board.yml
```yaml
# SPDX-FileCopyrightText: Copyright The Zephyr Project Contributors
# SPDX-License-Identifier: Apache-2.0

board:
  name: mch2022
  full_name: MCH2022 badge
  vendor: badgeteam
  socs:
  - name: esp32
```

## boards/espressif/esp32p4_function_ev_board/board.yml
```yaml
board:
  name: esp32p4_function_ev_board
  full_name: ESP32-P4-Function-EV-Board
  vendor: espressif
  socs:
  - name: esp32p4
  - name: esp32c6
  revision:
    format: major.minor.patch
    default: "1.5.2"
    revisions:
    - name: "1.0.0"
    - name: "1.5.2"
```

## boards/hackaday/communicator_badge/Kconfig.communicator_badge
```kconfig
# SPDX-FileCopyrightText: Copyright The Zephyr Project Contributors
# SPDX-License-Identifier: Apache-2.0

config BOARD_COMMUNICATOR_BADGE
	select SOC_ESP32S3
	select SOC_ESP32S3_PROCPU if BOARD_COMMUNICATOR_BADGE_ESP32S3_PROCPU
	select SOC_ESP32S3_APPCPU if BOARD_COMMUNICATOR_BADGE_ESP32S3_APPCPU
```

## boards/hackaday/communicator_badge/board.yml
```yaml
# SPDX-FileCopyrightText: Copyright The Zephyr Project Contributors
# SPDX-License-Identifier: Apache-2.0

board:
  name: communicator_badge
  full_name: Hackaday Communicator Badge
  vendor: hackaday
  socs:
  - name: esp32s3
```

## boards/why2025/why2025_badge/Kconfig
```kconfig
# SPDX-FileCopyrightText: Copyright The Zephyr Project Contributors
# SPDX-License-Identifier: Apache-2.0

config HEAP_MEM_POOL_ADD_SIZE_BOARD
	int
	default 4096

config WHY2025_BADGE_USB_TO_C6
	bool "Connect the USB-C port J8 to the ESP32-C6"
	depends on BOARD_WHY2025_BADGE_ESP32P4_HPCORE
	select BOARD_LATE_INIT_HOOK
	help
	  The ESP32-P4 selects with GPIO2 whether USB-C port J8 reaches its own
	  USB OTG controller or the USB-Serial-JTAG of the ESP32-C6. Enable this
	  to drive GPIO2 high and hand the port to the ESP32-C6, for example to
	  flash and run firmware on it.
```

## boards/why2025/why2025_badge/Kconfig.why2025_badge
```kconfig
# SPDX-FileCopyrightText: Copyright The Zephyr Project Contributors
# SPDX-License-Identifier: Apache-2.0

config BOARD_WHY2025_BADGE
	select SOC_ESP32P4_HPCORE if BOARD_WHY2025_BADGE_ESP32P4_HPCORE
	select SOC_ESP32P4_REV_1_3 if BOARD_WHY2025_BADGE_ESP32P4_HPCORE
	select SOC_ESP32C6 if BOARD_WHY2025_BADGE_ESP32C6_HPCORE
	select SOC_ESP32C6_HPCORE if BOARD_WHY2025_BADGE_ESP32C6_HPCORE
```

## boards/why2025/why2025_badge/board.yml
```yaml
# SPDX-FileCopyrightText: Copyright The Zephyr Project Contributors
# SPDX-License-Identifier: Apache-2.0

board:
  name: why2025_badge
  full_name: WHY2025 Badge
  vendor: why2025
  socs:
  - name: esp32p4
  - name: esp32c6
```

## drivers/display/Kconfig.nv3007
```kconfig
# SPDX-FileCopyrightText: Copyright The Zephyr Project Contributors
# SPDX-License-Identifier: Apache-2.0

config NV3007
	bool "NV3007 display driver"
	default y
	depends on DT_HAS_NEWVISION_NV3007_ENABLED
	select MIPI_DBI
	help
	  Enable driver for the New Vision NV3007 TFT LCD controller.
```

## drivers/display/Kconfig.st7703
```kconfig
# SPDX-FileCopyrightText: Copyright The Zephyr Project Contributors
# SPDX-License-Identifier: Apache-2.0

config ST7703
	bool "ST7703 display panel driver"
	default y
	depends on DT_HAS_SITRONIX_ST7703_ENABLED
	select MIPI_DSI
	select GPIO if $(dt_compat_any_has_prop,$(DT_COMPAT_SITRONIX_ST7703),bl-gpios) || \
		$(dt_compat_any_has_prop,$(DT_COMPAT_SITRONIX_ST7703),reset-gpios)
	help
	  Enable driver for the Sitronix ST7703 MIPI DSI panel controller.

config DISPLAY_ST7703_INIT_PRIORITY
	int "Initialization priority"
	depends on ST7703
	default MIPI_DSI_INIT_PRIORITY
	help
	  ST7703 display driver initialization priority. The panel attaches
	  to the MIPI DSI host, so it has to initialize after the host.
```

## drivers/gpio/Kconfig.mch2022_rp2040
```kconfig
# SPDX-FileCopyrightText: Copyright The Zephyr Project Contributors
# SPDX-License-Identifier: Apache-2.0

config GPIO_MCH2022_RP2040
	bool "MCH2022 badge FPGA lines on the RP2040"
	default y
	depends on DT_HAS_BADGETEAM_MCH2022_RP2040_GPIO_ENABLED
	depends on MFD_MCH2022_RP2040
	help
	  Enable the driver for the MCH2022 badge's FPGA reset and done lines,
	  which its RP2040 coprocessor holds and reads over I2C.

config GPIO_MCH2022_RP2040_INIT_PRIORITY
	int "Init priority"
	default 80
	depends on GPIO_MCH2022_RP2040
	help
	  Device driver initialization priority, after the coprocessor.
```

## drivers/input/Kconfig.mch2022_rp2040
```kconfig
# SPDX-FileCopyrightText: Copyright The Zephyr Project Contributors
# SPDX-License-Identifier: Apache-2.0

config INPUT_MCH2022_RP2040
	bool "MCH2022 badge buttons"
	default y
	depends on DT_HAS_BADGETEAM_MCH2022_RP2040_INPUT_ENABLED
	depends on MFD_MCH2022_RP2040
	help
	  Enable the driver for the MCH2022 badge's buttons and joystick, read
	  through its RP2040 coprocessor.
```

## drivers/input/Kconfig.tca8418
```kconfig
# SPDX-FileCopyrightText: Copyright The Zephyr Project Contributors
# SPDX-License-Identifier: Apache-2.0

config INPUT_TCA8418
	bool "TCA8418 keypad scan controller"
	default y
	depends on DT_HAS_TI_TCA8418_ENABLED
	select I2C
	help
	  Enable driver for the TI TCA8418 I2C keypad scan controller.
```

## drivers/led/Kconfig.mch2022_rp2040
```kconfig
# SPDX-FileCopyrightText: Copyright The Zephyr Project Contributors
# SPDX-License-Identifier: Apache-2.0

config LED_MCH2022_RP2040
	bool "MCH2022 badge LCD backlight"
	default y
	depends on DT_HAS_BADGETEAM_MCH2022_RP2040_BACKLIGHT_ENABLED
	depends on MFD_MCH2022_RP2040
	help
	  Enable the driver for the MCH2022 badge's LCD backlight, dimmed by
	  its RP2040 coprocessor. The backlight is LED 0.
```

## drivers/mfd/Kconfig.mch2022_rp2040
```kconfig
# SPDX-FileCopyrightText: Copyright The Zephyr Project Contributors
# SPDX-License-Identifier: Apache-2.0

config MFD_MCH2022_RP2040
	bool "MCH2022 badge RP2040 coprocessor"
	default y
	depends on DT_HAS_BADGETEAM_MCH2022_RP2040_ENABLED
	select I2C
	help
	  Enable the driver for the RP2040 coprocessor of the MCH2022 badge,
	  which reads the buttons and drives the LCD backlight.

config MFD_MCH2022_RP2040_DOWNLOAD_RESET
	bool "Allow the download mode reset over USB"
	default y
	depends on MFD_MCH2022_RP2040
	help
	  Clear the coprocessor's reset lock at boot, so that esptool can reset
	  the ESP32 into its serial bootloader through the RP2040's USB serial
	  port. The badge's stock firmware sets the lock and asks on the display
	  instead; the RP2040 keeps the lock until it loses power.
```

## dts/bindings/display/newvision,nv3007.yaml
```yaml
# SPDX-FileCopyrightText: Copyright The Zephyr Project Contributors
# SPDX-License-Identifier: Apache-2.0

title: New Vision NV3007 TFT LCD controller

description: |
  The New Vision NV3007 is a 262K colors TFT LCD controller with a
  168RGBx428 frame memory, driven over SPI. The driver writes 16-bit
  RGB565 pixels, most significant byte first (PIXEL_FORMAT_RGB_565X).

  Panels narrower than the frame memory sit at an offset in it, given by
  x-offset and y-offset in the orientation that madctl selects.

compatible: "newvision,nv3007"

include: [mipi-dbi-spi-device.yaml, display-controller.yaml]

properties:
  x-offset:
    type: int
    default: 0
    description: First frame memory column of the panel.

  y-offset:
    type: int
    default: 0
    description: First frame memory row of the panel.

  madctl:
    type: int
    default: 0x0
    description: |
      Memory data access control value (MY MX MV ML BGR MH). It sets the
      scan direction and orientation, for example 0xA0 (MY | MV) for a
      landscape panel rotated by 270 degrees.

  color-invert:
    type: boolean
    description: Inverts the display colors.

examples:
  - |
    #include <zephyr/dt-bindings/gpio/gpio.h>
    #include <zephyr/dt-bindings/mipi_dbi/mipi_dbi.h>

    mipi_dbi {
      compatible = "zephyr,mipi-dbi-spi";
      spi-dev = <&spi2>;
      dc-gpios = <&gpio1 7 GPIO_ACTIVE_HIGH>;
      reset-gpios = <&gpio1 8 GPIO_ACTIVE_LOW>;
      write-only;
      #address-cells = <1>;
      #size-cells = <0>;

      lcd@0 {
        compatible = "newvision,nv3007";
        reg = <0>;
        mipi-max-frequency = <80000000>;
        mipi-mode = "MIPI_DBI_MODE_SPI_4WIRE";
        width = <428>;
        height = <142>;
        madctl = <0xa0>;
        y-offset = <12>;
      };
    };
```

## dts/bindings/display/sitronix,st7703.yaml
```yaml
# SPDX-FileCopyrightText: Copyright The Zephyr Project Contributors
# SPDX-License-Identifier: Apache-2.0

title: Sitronix ST7703 MIPI DSI panel controller

description: |
  The Sitronix ST7703 drives TFT panels of up to 720x1440 pixels over MIPI
  DSI video mode. The driver carries the register settings of the 720x720
  panel of the WHY2025 badge on 2 data lanes; the video timing comes from
  the display-timings child node (compatible "zephyr,panel-timing").

compatible: "sitronix,st7703"

include: [mipi-dsi-device.yaml, display-controller.yaml]

properties:
  reset-gpios:
    type: phandle-array
    description: |
      Reset line, asserted to hold the controller in reset. A software reset
      is sent instead when absent.

  bl-gpios:
    type: phandle-array
    description: Backlight enable line, asserted to light the panel.

  madctl:
    type: int
    default: 0x0
    description: |
      Memory data access control value. Bit 3 (BGR) swaps red and blue for
      panels wired in BGR order.
```

## dts/bindings/fpga/lattice,ice40-fpga.yaml
```yaml
# Copyright (c) 2022 Meta
# SPDX-License-Identifier: Apache-2.0

description: Lattice iCE40 FPGA SPI based driver

compatible: "lattice,ice40-fpga"

include: lattice,ice40-fpga-base.yaml

properties:
  creset-hold:
    type: boolean
    description: |
      Keep CRESET_B asserted while no bitstream is loaded: at init, on the way into a load, after
      a failed load, and after fpga_off(), when fpga_on() refuses until the next load. For an
      iCE40 that shares its SPI bus: released with SPI_CS high, it boots as an SPI controller and
      drives the bus.
```

## dts/bindings/gpio/badgeteam,mch2022-rp2040-gpio.yaml
```yaml
# SPDX-FileCopyrightText: Copyright The Zephyr Project Contributors
# SPDX-License-Identifier: Apache-2.0

description: |
  The MCH2022 badge's FPGA lines on its RP2040 coprocessor

  Must be a child of a badgeteam,mch2022-rp2040 node. Pin 0 is the FPGA's
  CRESET_B, an output that releases it when high. Pin 1 is an input, low
  when the FPGA's CDONE is high. Each access is an I2C transfer, so these
  pins have no interrupts and cannot be used from an interrupt handler.

compatible: "badgeteam,mch2022-rp2040-gpio"

include: gpio-controller.yaml

properties:
  "#gpio-cells":
    const: 2

gpio-cells:
  - pin
  - flags
```

## dts/bindings/input/badgeteam,mch2022-rp2040-input.yaml
```yaml
# SPDX-FileCopyrightText: Copyright The Zephyr Project Contributors
# SPDX-License-Identifier: Apache-2.0

description: |
  MCH2022 badge buttons and joystick, read through the RP2040 coprocessor

  Must be a child of a badgeteam,mch2022-rp2040 node.

compatible: "badgeteam,mch2022-rp2040-input"

properties:
  int-gpios:
    type: phandle-array
    description: |
      The coprocessor's active-low interrupt line, asserted when a button
      changes. The buttons are polled when it is not set.

  poll-period-ms:
    type: int
    default: 30
    description: |
      Polling period without an interrupt line. The coprocessor samples the
      buttons every 30 ms.

  zephyr,codes:
    type: array
    required: true
    description: |
      Input codes for HOME, MENU, START, A (accept), B (back), SELECT,
      joystick left, joystick press, joystick down, joystick up and joystick
      right, in this order. A code of 0 leaves the button unreported.
```
